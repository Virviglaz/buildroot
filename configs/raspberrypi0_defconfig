## configs/raspberrypi0_defconfig
```kconfig
BR2_arm=y
BR2_arm1176jzf_s=y
BR2_TOOLCHAIN_EXTERNAL=y
BR2_TOOLCHAIN_EXTERNAL_BOOTLIN_ARMV6_EABIHF_GLIBC_STABLE=y
BR2_PACKAGE_HOST_GDB=y
BR2_GLOBAL_PATCH_DIR="board/raspberrypi/patches"
BR2_DOWNLOAD_FORCE_CHECK_HASHES=y
BR2_TARGET_GENERIC_HOSTNAME="eBikeGTK"
BR2_TARGET_GENERIC_ISSUE="Welcome to embedded Linux"
BR2_ROOTFS_DEVICE_CREATION_DYNAMIC_EUDEV=y
BR2_TARGET_GENERIC_ROOT_PASSWD="123"
BR2_TARGET_TZ_INFO=y
BR2_TARGET_LOCALTIME="Europe/Amsterdam"
BR2_ROOTFS_OVERLAY="board/raspberrypi0/rootfs-overlay"
BR2_ROOTFS_POST_BUILD_SCRIPT="board/raspberrypi0/post-build.sh"
BR2_ROOTFS_POST_IMAGE_SCRIPT="board/raspberrypi0/post-image.sh"
BR2_LINUX_KERNEL=y
BR2_LINUX_KERNEL_CUSTOM_TARBALL=y
BR2_LINUX_KERNEL_CUSTOM_TARBALL_LOCATION="$(call github,raspberrypi,linux,21b410140c47ffab5668399f6f143c7d7b935c8b)/linux-21b410140c47ffab5668399f6f143c7d7b935c8b.tar.gz"
BR2_LINUX_KERNEL_USE_CUSTOM_CONFIG=y
BR2_LINUX_KERNEL_CUSTOM_CONFIG_FILE="board/raspberrypi0/linux-config-pi0"
BR2_LINUX_KERNEL_DTS_SUPPORT=y
BR2_LINUX_KERNEL_INTREE_DTS_NAME="broadcom/bcm2708-rpi-zero"
BR2_LINUX_KERNEL_NEEDS_HOST_OPENSSL=y
BR2_PACKAGE_BUSYBOX_SHOW_OTHERS=y
BR2_PACKAGE_EBIKEGTK=y
BR2_PACKAGE_XZ=y
BR2_PACKAGE_GDB=y
BR2_PACKAGE_SSHFS=y
BR2_PACKAGE_DEJAVU=y
BR2_PACKAGE_EFL=y
# BR2_PACKAGE_EFL_GSTREAMER1 is not set
# BR2_PACKAGE_EFL_LIBFRIBIDI is not set
# BR2_PACKAGE_EFL_LIBSNDFILE is not set
# BR2_PACKAGE_EFL_PULSEAUDIO is not set
BR2_PACKAGE_EFL_FB=y
BR2_PACKAGE_LIBGLVND=y
BR2_PACKAGE_MESA3D=y
BR2_PACKAGE_MESA3D_LLVM=y
BR2_PACKAGE_MESA3D_GALLIUM_DRIVER_VC4=y
BR2_PACKAGE_MESA3D_VULKAN_DRIVER_BROADCOM=y
BR2_PACKAGE_MESA3D_OPENGL_GLX=y
BR2_PACKAGE_MESA3D_OPENGL_ES=y
BR2_PACKAGE_WESTON=y
BR2_PACKAGE_WESTON_XWAYLAND=y
BR2_PACKAGE_XORG7=y
BR2_PACKAGE_XSERVER_XORG_SERVER=y
BR2_PACKAGE_XAPP_XCLOCK=y
BR2_PACKAGE_XAPP_XDRIINFO=y
BR2_PACKAGE_XAPP_XINIT=y
BR2_PACKAGE_XDRIVER_XF86_VIDEO_FBDEV=y
BR2_PACKAGE_XFONT_FONT_XFREE86_TYPE1=y
BR2_PACKAGE_LINUX_FIRMWARE=y
BR2_PACKAGE_LINUX_FIRMWARE_RALINK_RT2XX=y
BR2_PACKAGE_RPI_FIRMWARE=y
BR2_PACKAGE_RPI_FIRMWARE_BOOTCODE_BIN=y
BR2_PACKAGE_RPI_FIRMWARE_VARIANT_PI=y
BR2_PACKAGE_RPI_FIRMWARE_VARIANT_PI_X=y
BR2_PACKAGE_RPI_FIRMWARE_CONFIG_FILE="board/raspberrypi0/config_default.txt"
BR2_PACKAGE_LUAJIT=y
BR2_PACKAGE_LIBSHA1=y
BR2_PACKAGE_GTKMM4=y
BR2_PACKAGE_LIBGTK4=y
# BR2_PACKAGE_LIBGTK4_BROADWAY is not set
# BR2_PACKAGE_LIBGTK4_X11 is not set
BR2_PACKAGE_BCM2835=y
BR2_PACKAGE_DTC=y
BR2_PACKAGE_DTC_PROGRAMS=y
BR2_PACKAGE_DROPBEAR=y
BR2_PACKAGE_NTP=y
BR2_PACKAGE_NTP_NTPDATE=y
BR2_PACKAGE_WIRELESS_TOOLS=y
BR2_PACKAGE_WPA_SUPPLICANT=y
BR2_PACKAGE_WPA_SUPPLICANT_WPS=y
BR2_PACKAGE_WPA_SUPPLICANT_CLI=y
BR2_PACKAGE_WPA_SUPPLICANT_WPA_CLIENT_SO=y
BR2_PACKAGE_WPA_SUPPLICANT_PASSPHRASE=y
BR2_PACKAGE_KMOD_TOOLS=y
BR2_TARGET_ROOTFS_EXT2=y
BR2_TARGET_ROOTFS_EXT2_4=y
BR2_TARGET_ROOTFS_EXT2_SIZE="320M"
# BR2_TARGET_ROOTFS_TAR is not set
BR2_PACKAGE_HOST_DOSFSTOOLS=y
BR2_PACKAGE_HOST_GENIMAGE=y
BR2_PACKAGE_HOST_KMOD_XZ=y
BR2_PACKAGE_HOST_MTOOLS=y
```

## package/eBikeGTK/Config.in
```kconfig
config BR2_PACKAGE_EBIKEGTK
    bool "eBikeGTK"
    depends on BR2_PACKAGE_GTKMM4
    help
        Electric bikes monitoring application.

        https://github.com/Virviglaz/eBikeGTK
```

## package/gtkmm4/Config.in
```kconfig
comment "gtkmm4 needs libgtk4 and a toolchain w/ C++, wchar, threads, gcc >= 4.9, dynamic library"
	depends on BR2_USE_MMU
	depends on BR2_TOOLCHAIN_HAS_SYNC_4
	depends on !BR2_TOOLCHAIN_GCC_AT_LEAST_4_9 || !BR2_USE_WCHAR \
		|| !BR2_INSTALL_LIBSTDCPP || !BR2_PACKAGE_LIBGTK4 \
		|| !BR2_TOOLCHAIN_HAS_THREADS || \
		BR2_STATIC_LIBS

config BR2_PACKAGE_GTKMM4
	bool "gtkmm4"
	depends on BR2_TOOLCHAIN_HAS_SYNC_4 # pangomm, libgtk4 -> pango -> harfbuzz
	depends on BR2_INSTALL_LIBSTDCPP # glibmm, libpangomm -> glibmm/pango
	depends on BR2_TOOLCHAIN_GCC_AT_LEAST_4_9 # C++11
	depends on BR2_TOOLCHAIN_HAS_THREADS # *mm/libgtk3 -> libglib2
	depends on BR2_USE_MMU # *mm/libgtk4 -> libglib2
	depends on BR2_USE_WCHAR # *mm/libgtk4 -> libglib2
	depends on BR2_PACKAGE_LIBGTK4
	depends on !BR2_STATIC_LIBS # atkmm
	select BR2_PACKAGE_ATKMM
	select BR2_PACKAGE_CAIROMM
	select BR2_PACKAGE_GLIBMM
	select BR2_PACKAGE_LIBSIGC3
	select BR2_PACKAGE_PANGOMM
	help
	  The gtkmm4 package is a set of C++ bindings for GTK 4.

	  http://www.gtkmm.org/
```
